## apps/examples/appendtest/Kconfig
```kconfig
#
# For a description of the syntax of this configuration file,
# see kconfig-language at https://www.kernel.org/doc/Documentation/kbuild/kconfig-language.txt
#

config EXAMPLES_APPENDTEST
	bool "Append Test App"
	default n
	---help---
		Enable the Append Test App

if EXAMPLES_APPENDTEST

menu option
config EXAMPLES_APPENDTEST_READBACKVERIFY
	bool "ReadBack and Verification"
	default n
	depends on EXAMPLES_APPENDTEST
endmenu
endif

config USER_ENTRYPOINT
	string
	default "appendtest_main" if ENTRY_APPENDTEST
	
```
